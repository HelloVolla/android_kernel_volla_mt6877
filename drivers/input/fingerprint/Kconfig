## drivers/input/fingerprint/Kconfig
```kconfig
#
#Fingerprint
#
menu "Fingerprint support"
	depends on INPUT

config MTK_FINGERPRINT_SUPPORT
	bool "Mediatek Fingerprint"
	default n
	help
	  Fingerprint mtk driver enable/disable
	  in the kernel.Say Y here if you want to
	  use mediatek fingerprint driver,fingerprint
	  driver will support fingerprint function

config MTK_FINGERPRINT_SELECT
	string "sensor type"
	default "NA"

config MTK_FINGERPRINT_SELECT_2
	string "sensor type"
	default "NA"


if MTK_FINGERPRINT_SELECT = "FPC1145"
config FPC_FINGERPRINT
	bool "FPC Fingerprint"
	default y
	help
	  FPC fingerprint FPC's 102x/104x device.
endif

if MTK_FINGERPRINT_SELECT = "GF3658" ||  MTK_FINGERPRINT_SELECT = "GF5216"
config GOODIX_FINGERPRINT
	bool "Goodix Fingerprint"
#prize modify by mhy start
	default n
#prize modify by mhy end
	help
	  Goodix Fingerprint chip GF316M/GF318M/
	  GF3118M/GF518M/GF5118M/GF516M/GF816M/
	  GF3208/GF3206/GF3266/GF3288/GF5206/
	  GF5216/GF5208 TEE driver

config GOODIX_SENSOR_TYPE
	string "SENSOR_TYPE"
	default "GF5216"
	help
	  Must input sensor type, or default is
	  GF316M GF318M GF3118M GF518M GF5118M
	  GF516M GF816M GF3208 GF3206 GF3266
	  GF3288 GF5206 GF5216 GF5208
endif
# begin, prize-pengguangyi-20190121, add for goodix gf5118m fp
config GOODIX_GF5118M_FINGERPRINT
	bool "Goodix GF5118M Fingerprint"
	default n
	---help---
	Goodix Fingerprint chip GF316M/GF318M/GF3118M/GF518M/GF5118M/GF516M/GF816M/GF3208/GF3206/GF3266/GF3288/GF5206 TEE driver
# end, prize-pengguangyi-20190121, add for goodix gf5118m fp

if MTK_FINGERPRINT_SELECT = "gw9518"
  config GOODIX_GW9518_FINGERPRINT
     bool "Goodix GW9518 Fingerprint"
     default y
     ---help---
     Goodix Fingerprint chip GW9518  TEE driver
endif

#prize-add-pengzhipeng-20191105-start
if MTK_FINGERPRINT_SELECT = "ft9362"
  config FT9362_FINGERPRINT
     bool "FT9362 Fingerprint"
     default y
     ---help---
     MICROARRAY fingerprint FT9362's device.
endif

if MTK_FINGERPRINT_SELECT_2 = "ft9362_tee"
  config FT9362_FINGERPRINT_TEE
     bool "FT9362 TEE Fingerprint"
     default y
     ---help---
     MICROARRAY fingerprint FT9362 TEE's device.
endif
if MTK_FINGERPRINT_SELECT = "sunwave_driver_all_in_one"
  config MTK_FINGERPRINT_SUNWAVECORP
       bool "Sunwave Fingerprint"
       default y
	---help---
     MICROARRAY fingerprint Sunwave's device.
endif
#prize-add-pengzhipeng-20191105-end

#prize added by huarui, add fp driver, 20190327-start
if MTK_FINGERPRINT_SELECT = "chipone_ree"
config CHIPONE_FINGERPRINT_REE
	bool "CHIPONE Fingerprint"
	default y
	help
	  CHIPONE fingerprint CHIPONE's device.
endif
#prize added by huarui, add tp driver, 20190327-end


#prize add by lipengpeng 20200628 start
if MTK_FINGERPRINT_SELECT = "chipone_tee"
config CHIPONE_FINGERPRINT_TEE
	bool "CHIPONE Fingerprint"
	default y
	help
	  CHIPONE fingerprint CHIPONE's device.
endif
#prize add by lipengpeng 20200628 end

#prize added by chenjiaxi, cdfinger ree new fingerprint, 20200711-start
if MTK_FINGERPRINT_SELECT = "cdfinger_ree"
  config MTK_CDFINGER_REE
       bool "Cdfinger Fingerprint"
       default y
	---help---
     CDFINGER fingerprint Cdfinger's device.
endif
#prize added by chenjiaxi, cdfinger ree new fingerprint, 20200711-end


# prize-add-xuxiaoming-20200112-start
source "drivers/input/fingerprint/silead/Kconfig"
# prize-add-xuxiaoming-20200112-end

#prize added by huarui, add fp driver, 20190327-start
config PRIZE_FP_USE_VFP
	bool "Fingerprint power vfp"
	default n
	help
	  CHIPONE fingerprint CHIPONE's device.
#prize added by huarui, add tp driver, 20190327-end

#prize added by chenjiaxi, fortsense fingerprint, 20210410-start
if MTK_FINGERPRINT_SELECT = "fortsense_driver_all_in_one"
  config MTK_FINGERPRINT_FORTSENSE
       bool "Fortsense Fingerprint"
       default y
	---help---
     fortsense fingerprint Fortsense's device.
endif
#prize added by chenjiaxi, fortsense fingerprint, 20210410-end
#prize-add finger-wangyongsheng-20210327-start
if MTK_FINGERPRINT_SELECT = "microarray_fp"
config MICROARRAY_FP
    bool "microarray Fingerprint"
	default y
	---help---
	microarray fingerprint.
endif
#prize-add finger-wangyongsheng-20210327-end
endmenu
```

## drivers/input/touchscreen/ILITEK_V3.0.9.0/Kconfig
```kconfig
#
# ILITEK Touchscreen driver configuration
#

config TOUCHSCREEN_ILITEK_GLOVE_MODE
	bool "ILITEK glove mode support"
	help
	  This enables support for ILITEK CHIPSET over I2C based touchscreens.
	  when turn this option on, TOUCHSCREEN_ILITEK_I2C touch driver
	  will open.
	  If unsure,say N.

config TOUCHSCREEN_ILITEK_GESTURE_MODE
	bool "ILITEK gesture mode support"
	help
	  This enables support for ILITEK CHIPSET over I2C based touchscreens.
	  when turn this option on, TOUCHSCREEN_ILITEK_I2C touch driver
	  will open.
	  If unsure,say N.
```

## drivers/input/touchscreen/NT36672N/Kconfig
```kconfig
#
# Novatek NT36xxx touchscreen driver configuration
#
config TOUCHSCREEN_MTK_NT36672N
	bool "Novatek NT36xxx"
	default y
	help
	  Say Y here if you have a Novatek NT36xxx touchscreen connected
	  to your system.

	  If unsure, say N.

config TOUCHSCREEN_NT36672_GLOVE_MODE
	bool "ILITEK glove mode support"
	help
	  This enables support for ILITEK CHIPSET over I2C based touchscreens.
	  when turn this option on, TOUCHSCREEN_ILITEK_I2C touch driver
	  will open.
	  If unsure,say N.

config TOUCHSCREEN_NT36672_GESTURE_MODE
	bool "ILITEK gesture mode support"
	help
	  This enables support for ILITEK CHIPSET over I2C based touchscreens.
	  when turn this option on, TOUCHSCREEN_ILITEK_I2C touch driver
	  will open.
	  If unsure,say N.
```

## drivers/input/touchscreen/mediatek/hynitron/Kconfig
```kconfig
#
# Touchscreen driver configuration
#
config TOUCHSCREEN_HYNITRON
    bool "hynitorn Ts for TOUCHSCREEN"
    depends on I2C
    default n
    help
      Say Y here if you have hynitorn touch panel.
      If unsure, say N.
      
    
```

## drivers/input/touchscreen/mediatek/tlsc6x/Kconfig
```kconfig
#
# tlsc6x touchscreen driver configuration
#

config TOUCHSCREEN_TLSC6X
	bool "tlsc6x"
	help
	  Say Y here if you have a tlsc6x touchscreen connected
	  to your system.

	  If unsure, say N.
```

## drivers/input/touchscreen/sitronix_ts_v43.00.230509/Kconfig
```kconfig
#
# SITRONIX Touchscreen driver configuration
#

config TOUCHSCREEN_SITRONIX_GLOVE_MODE
	bool "SITRONIX glove mode support"
	help
	  This enables support for SITRONIX CHIPSET over I2C based touchscreens.
	  when turn this option on, TOUCHSCREEN_ILITEK_I2C touch driver
	  will open.
	  If unsure,say N.

config TOUCHSCREEN_SITRONIX_GESTURE_MODE
	bool "SITRONIX gesture mode support"
	help
	  This enables support for SITRONIX CHIPSET over I2C based touchscreens.
	  when turn this option on, TOUCHSCREEN_ILITEK_I2C touch driver
	  will open.
	  If unsure,say N.
```

## drivers/input/touchscreen/synaptics_tcm/Kconfig
```kconfig
#
# Goodix touchscreen driver configuration
#
config TOUCHSCREEN_SYNAPTICS_TCM
	tristate "Goodix berlin touchscreen"
	help
	  Say Y here if you have a Goodix berlin series touch controller
	  to your system.
	  If build module, say M.
	  If unsure, say N.
```

## drivers/misc/mediatek/rtc/Kconfig
```kconfig
# RTC Related
config MTK_RTC
	bool "MediaTek Real Time Clock Support"
	default n
	help
	  A real-time clock (RTC) is a computer
	  clock (most often in the form of an
	  integrated circuit) that keeps track
	  of the current time.

# prize added by chenjiaxi, emmc test, 20220518-start
config PRIZE_EMMC_TEST
	bool "prize emmc test"
 	default n
	help
	  prize emmc test
# prize added by chenjiaxi, emmc test, 20220518-end
```

## drivers/misc/mediatek/scan_key/Kconfig
```kconfig
config PRIZE_SCAN_HANDSHANK_KEY
	bool "KEY for SCAN_HANDSHANK"
	help
	  It support SCAN_HANDSHANK control.
```

## drivers/misc/mediatek/sensors-1.0/accelerometer/stk8xxx/Kconfig
```kconfig
config MTK_STK8XXX
	bool "MTK_STK8XXX for MediaTek package"
	default n
	help
	  The STK8XXX is a highly integrated,
	  low power internal measurement unit
	  that provides precise acceleration
	  measurement.
	  this config will turn on accelerometer feature.
```

## drivers/misc/mediatek/sensors-1.0/barometer/BKTF_2ND_SPL07/Kconfig
```kconfig
config BKTF_2ND_SPL07
	bool "SPL07 for MediaTek package"
	default n
	help
	  It support different type sensor
	  in this platform. If this option
	  is set, it will support pressure
	  SPL07.
```

## drivers/misc/mediatek/sensors-1.0/barometer/Kconfig
```kconfig
config CUSTOM_KERNEL_BAROMETER
	bool "CUSTOM KERNEL BAROMETER Config"
	help
	  one load to support different barometer sensor.
	  This feature Option is used for projects which using more than one
	  barometer, and be auto detected by setting this option to yes
	  If unsure, say N.

source "drivers/misc/mediatek/sensors-1.0/barometer/barohub/Kconfig"
source "drivers/misc/mediatek/sensors-1.0/barometer/BMP280-new/Kconfig"
# prize added by chenjiaxi, add BKTF_2ND_SPL07 drivers, 20220407-start
source "drivers/misc/mediatek/sensors-1.0/barometer/BKTF_2ND_SPL07/Kconfig"
# prize added by chenjiaxi, add BKTF_2ND_SPL07 drivers, 20220407-end
# prize added by chenjiaxi, add icp201xx drivers, 20220606-start
source "drivers/misc/mediatek/sensors-1.0/barometer/icp201xx/Kconfig"
# prize added by chenjiaxi, add icp201xx drivers, 20220606-end
```

## drivers/misc/mediatek/sensors-1.0/barometer/icp201xx/Kconfig
```kconfig
config MTK_ICP201XX
	bool "ICP201XX for MediaTek package"
	default n
	help
	  It support different type sensor
	  in this platform. If this option
	  is set, it will support pressure
	  BMP280.
```

## drivers/misc/mediatek/switch_battery/Kconfig
```kconfig
config SWITCH_BATTERY
	bool "SWITCH for BATTERY"
	help
	  It support Battery Switch status.
```

## drivers/resmon/Kconfig
```kconfig
#
# RESMON configuration
#

menu "RESMON Configuration Support"

config RESMON
	tristate "RESMON Configuration "
	default n
	help
	  Say Y here if you want support for configuring RESMON from the
	  kernel.  The RESMON application adds a RESMON monitor and RESMON driver.

config RESMON_DEBUG
        tristate "RESMON_DEBUG Configuration "
        depends on RESMON
        default n
        help
          Say Y here if you want support for process debug info.

config RESMON_KILL_DEBUG
        tristate "RESMON_KILL_DEBUG Configuration "
        depends on RESMON
        default n
        help
          Say Y here if you want support for process kill/dead lock, etc.
endmenu
```
