// SPDX-License-Identifier: GPL-2.0
/*
 * Copyright (c) 2021 MediaTek Inc.
 */

/* TOUCH start */
&i2c0 {
	clock-frequency = <400000>;

	gt9916@5d {
		compatible = "goodix,brl-d";
		reg = <0x5d>;
		status = "ok";
		interrupt-parent = <&pio>;
		interrupts = <14 IRQ_TYPE_EDGE_FALLING 14 0>;
		
		goodix,avdd-name = "avdd";
		goodix,iovdd-name = "iovdd";
		avdd-supply = <&mt_pmic_vtp_ldo_reg>;
		
		
		goodix,irq-gpio = <&pio 14 0x0>;
		goodix,reset-gpio = <&pio 15 0x0>;
		goodix,irq-flags = <1>; /* 1:rising, 2:falling;*/
		
		goodix,firmware-name = "goodix_firmware.bin";
		goodix,config-name = "goodix_cfg_group.bin";
		
		goodix,panel-max-x = <8640>;
		goodix,panel-max-y = <19200>;
		goodix,panel-max-w = <255>;
		goodix,panel-max-p = <4096>;

		/*goodix,swap-axis;*/
		/*goodix,x2x;*/
		/*goodix,y2y;*/
		/*goodix,pen-enable;*/
	};

};


/* TOUCH end */
